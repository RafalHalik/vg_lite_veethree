## Kconfig
```kconfig
config VG_LITE_VEETHREE
    bool "Enable Hardware acceleration for veethree apps"
    depends on LVGL_VEETHREE
    help
      Enable this setting to use hardware acceleration for graphics applications this must be used in conjuction with lvgl
```
